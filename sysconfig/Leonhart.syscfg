/**
 * These arguments were used when this file was generated. They will be automatically applied on subsequent loads
 * via the GUI or CLI. Run CLI with '--help' for additional information on how to override these arguments.
 * @cliArgs --device "AM62x" --part "AM6231-G" --package "ALW"
 * @v2CliArgs --device "AM623" --package "FCBGA (ALW)" --variant "AM6231-G"
 * @versions {"tool":"1.24.2+4234"}
 */

/**
 * Import the modules used in this configuration.
 */
const powerDomains = scripting.addModule("/ti/corePinmux/powerDomains");

/**
 * Write custom configuration values to the imported modules.
 */
powerDomains.VDDSHV0                = "3.3 V";
powerDomains.VDDSHV1                = "3.3 V";
powerDomains["VDDS_DDR-VDDS_DDR_C"] = "1.2 V";

/**
 * These are the peripherals and settings in this configuration
 */
const DDRSS1                      = scripting.addPeripheral("DDRSS");
DDRSS1.$name                      = "DDR4";
DDRSS1.A0.$assign                 = "DDR0_A0";
DDRSS1.A1.$assign                 = "DDR0_A1";
DDRSS1.A10.$assign                = "DDR0_A10";
DDRSS1.A11.$assign                = "DDR0_A11";
DDRSS1.A12.$assign                = "DDR0_A12";
DDRSS1.A13.$assign                = "DDR0_A13";
DDRSS1.A2.$assign                 = "DDR0_A2";
DDRSS1.A3.$assign                 = "DDR0_A3";
DDRSS1.A4.$assign                 = "DDR0_A4";
DDRSS1.A5.$assign                 = "DDR0_A5";
DDRSS1.A6.$assign                 = "DDR0_A6";
DDRSS1.A7.$assign                 = "DDR0_A7";
DDRSS1.A8.$assign                 = "DDR0_A8";
DDRSS1.A9.$assign                 = "DDR0_A9";
DDRSS1.ACT_n.$assign              = "DDR0_ACT_n";
DDRSS1.ALERT_n.$assign            = "DDR0_ALERT_n";
DDRSS1.BA0.$assign                = "DDR0_BA0";
DDRSS1.BA1.$assign                = "DDR0_BA1";
DDRSS1.BG0.$assign                = "DDR0_BG0";
DDRSS1.BG1.$assign                = "DDR0_BG1";
DDRSS1.CAS_n.$assign              = "DDR0_CAS_n";
DDRSS1.CK0.$assign                = "DDR0_CK0";
DDRSS1.CK0_n.$assign              = "DDR0_CK0_n";
DDRSS1.CKE0.$assign               = "DDR0_CKE0";
DDRSS1.CKE1.$assign               = "DDR0_CKE1";
DDRSS1.CS0_n.$assign              = "DDR0_CS0_n";
DDRSS1.CS1_n.$assign              = "DDR0_CS1_n";
DDRSS1.DM0.$assign                = "DDR0_DM0";
DDRSS1.DM1.$assign                = "DDR0_DM1";
DDRSS1.DQ0.$assign                = "DDR0_DQ0";
DDRSS1.DQ1.$assign                = "DDR0_DQ1";
DDRSS1.DQ10.$assign               = "DDR0_DQ10";
DDRSS1.DQ11.$assign               = "DDR0_DQ11";
DDRSS1.DQ12.$assign               = "DDR0_DQ12";
DDRSS1.DQ13.$assign               = "DDR0_DQ13";
DDRSS1.DQ14.$assign               = "DDR0_DQ14";
DDRSS1.DQ15.$assign               = "DDR0_DQ15";
DDRSS1.DQ2.$assign                = "DDR0_DQ2";
DDRSS1.DQ3.$assign                = "DDR0_DQ3";
DDRSS1.DQ4.$assign                = "DDR0_DQ4";
DDRSS1.DQ5.$assign                = "DDR0_DQ5";
DDRSS1.DQ6.$assign                = "DDR0_DQ6";
DDRSS1.DQ7.$assign                = "DDR0_DQ7";
DDRSS1.DQ8.$assign                = "DDR0_DQ8";
DDRSS1.DQ9.$assign                = "DDR0_DQ9";
DDRSS1.DQS0.$assign               = "DDR0_DQS0";
DDRSS1.DQS0_n.$assign             = "DDR0_DQS0_n";
DDRSS1.DQS1.$assign               = "DDR0_DQS1";
DDRSS1.DQS1_n.$assign             = "DDR0_DQS1_n";
DDRSS1.ODT0.$assign               = "DDR0_ODT0";
DDRSS1.ODT1.$assign               = "DDR0_ODT1";
DDRSS1.PAR.$assign                = "DDR0_PAR";
DDRSS1.RAS_n.$assign              = "DDR0_RAS_n";
DDRSS1.RESET0_n.$assign           = "DDR0_RESET0_n";
DDRSS1.WE_n.$assign               = "DDR0_WE_n";
DDRSS1.CAL0.$assign               = "DDR0_CAL0";
const GPIO1                       = scripting.addPeripheral("GPIO");
GPIO1["0"].$used                  = false;
GPIO1["1"].$used                  = false;
GPIO1["2"].$used                  = false;
GPIO1["3"].$used                  = false;
GPIO1["4"].$used                  = false;
GPIO1["5"].$used                  = false;
GPIO1["6"].$used                  = false;
GPIO1["7"].$used                  = false;
GPIO1["8"].$used                  = false;
GPIO1["9"].$used                  = false;
GPIO1["10"].$used                 = false;
GPIO1["11"].$used                 = false;
GPIO1["12"].$used                 = false;
GPIO1["13"].$used                 = false;
GPIO1["14"].$used                 = false;
GPIO1["15"].$used                 = false;
GPIO1["16"].$used                 = false;
GPIO1["17"].$used                 = false;
GPIO1["18"].$used                 = false;
GPIO1["19"].$used                 = false;
GPIO1["20"].$used                 = false;
GPIO1["21"].$used                 = false;
GPIO1["22"].$used                 = false;
GPIO1["23"].$used                 = false;
GPIO1["24"].$used                 = false;
GPIO1["25"].$used                 = false;
GPIO1["26"].$used                 = false;
GPIO1["27"].$used                 = false;
GPIO1["28"].$used                 = false;
GPIO1["29"].$used                 = false;
GPIO1["30"].$used                 = false;
GPIO1["31"].$used                 = false;
GPIO1["32"].$used                 = false;
GPIO1["33"].$used                 = false;
GPIO1["34"].$used                 = false;
GPIO1["35"].$used                 = false;
GPIO1["36"].$used                 = false;
GPIO1["37"].$used                 = false;
GPIO1["38"].$used                 = false;
GPIO1["39"].$used                 = false;
GPIO1["40"].$used                 = false;
GPIO1["41"].$used                 = false;
GPIO1["42"].$used                 = false;
GPIO1["43"].$used                 = false;
GPIO1["44"].$used                 = false;
GPIO1["45"].$used                 = false;
GPIO1["46"].$used                 = false;
GPIO1["47"].$used                 = false;
GPIO1["48"].$used                 = false;
GPIO1["49"].$used                 = false;
GPIO1["50"].$used                 = false;
GPIO1["51"].$used                 = false;
GPIO1["52"].$used                 = false;
GPIO1["53"].$used                 = false;
GPIO1["54"].$used                 = false;
GPIO1["55"].$used                 = false;
GPIO1["56"].$used                 = false;
GPIO1["57"].$used                 = false;
GPIO1["58"].$used                 = false;
GPIO1["59"].pu_pd                 = "pu";
GPIO1["59"].$assign               = "VOUT0_DATA14";
GPIO1["59"].$used                 = true;
GPIO1["60"].pu_pd                 = "pu";
GPIO1["60"].$assign               = "VOUT0_DATA15";
GPIO1["60"].$used                 = true;
GPIO1["61"].$used                 = false;
GPIO1["62"].$used                 = false;
GPIO1["63"].$used                 = false;
GPIO1["64"].$used                 = false;
GPIO1["65"].pu_pd                 = "pu";
GPIO1["65"].$assign               = "MMC2_DAT3";
GPIO1["65"].$used                 = true;
GPIO1["66"].$used                 = false;
GPIO1["67"].$used                 = false;
GPIO1["68"].$used                 = false;
GPIO1["69"].$used                 = false;
GPIO1["70"].$used                 = false;
GPIO1["71"].$used                 = false;
GPIO1["72"].$used                 = false;
GPIO1["73"].$used                 = false;
GPIO1["74"].$used                 = false;
GPIO1["75"].$used                 = false;
GPIO1["76"].$used                 = false;
GPIO1["77"].$used                 = false;
GPIO1["78"].$used                 = false;
GPIO1["79"].$used                 = false;
GPIO1["80"].$used                 = false;
GPIO1["81"].$used                 = false;
GPIO1["82"].$used                 = false;
GPIO1["83"].$used                 = false;
GPIO1["84"].$used                 = false;
GPIO1["85"].$used                 = false;
GPIO1["86"].$used                 = false;
GPIO1["87"].$used                 = false;
GPIO1["88"].$used                 = false;
GPIO1["89"].$used                 = false;
GPIO1["90"].$used                 = false;
GPIO1["91"].$used                 = false;
GPIO1.$name                       = "MyGPIO1";
const MDIO1                       = scripting.addPeripheral("MDIO");
MDIO1.$name                       = "Ethernet MDIO";
MDIO1.$assign                     = "MDIO0";
MDIO1.MDC.$assign                 = "MDIO0_MDC";
MDIO1.MDIO.pu_pd                  = "pu";
MDIO1.MDIO.$assign                = "MDIO0_MDIO";
const MMC01                       = scripting.addPeripheral("MMC0");
MMC01.$name                       = "eMMC";
MMC01.CMD.$assign                 = "MMC0_CMD";
MMC01.CLK.pu_pd                   = "pd";
MMC01.CLK.rx                      = false;
MMC01.CLK.$assign                 = "MMC0_CLK";
MMC01.DAT0.$assign                = "MMC0_DAT0";
MMC01.DAT1.$assign                = "MMC0_DAT1";
MMC01.DAT2.$assign                = "MMC0_DAT2";
MMC01.DAT3.$assign                = "MMC0_DAT3";
MMC01.DAT4.$assign                = "MMC0_DAT4";
MMC01.DAT5.$assign                = "MMC0_DAT5";
MMC01.DAT6.$assign                = "MMC0_DAT6";
MMC01.DAT7.$assign                = "MMC0_DAT7";
const MMC11                       = scripting.addPeripheral("MMC1");
MMC11.$name                       = "SD";
MMC11.CMD.pu_pd                   = "pu";
MMC11.CMD.$assign                 = "MMC1_CMD";
MMC11.CLK.pu_pd                   = "nopull";
MMC11.CLK.rx                      = false;
MMC11.CLK.$assign                 = "MMC1_CLK";
MMC11.DAT0.pu_pd                  = "pu";
MMC11.DAT0.$assign                = "MMC1_DAT0";
MMC11.DAT1.$assign                = "MMC1_DAT1";
MMC11.DAT2.$assign                = "MMC1_DAT2";
MMC11.DAT3.$assign                = "MMC1_DAT3";
MMC11.SDCD.pu_pd                  = "nopull";
MMC11.SDCD.$assign                = "MMC1_SDCD";
MMC11.SDWP.$assign                = "MMC1_SDWP";
scripting.suppress("Voltage conflict,VDDSHV0 is set to 3\\.3 V", MMC11, "SDCD");
scripting.suppress("Voltage conflict,VDDSHV0 is set to 3\\.3 V", MMC11, "SDWP");
const RGMII1                      = scripting.addPeripheral("RGMII");
RGMII1.$name                      = "Ethernet";
RGMII1.RD0.pu_pd                  = "pu";
RGMII1.RD0.$assign                = "RGMII1_RD0";
RGMII1.RD1.pu_pd                  = "pu";
RGMII1.RD1.$assign                = "RGMII1_RD1";
RGMII1.RD2.pu_pd                  = "pd";
RGMII1.RD2.$assign                = "RGMII1_RD2";
RGMII1.RD3.pu_pd                  = "pu";
RGMII1.RD3.$assign                = "RGMII1_RD3";
RGMII1.RXC.pu_pd                  = "pd";
RGMII1.RXC.$assign                = "RGMII1_RXC";
RGMII1.RX_CTL.pu_pd               = "pd";
RGMII1.RX_CTL.$assign             = "RGMII1_RX_CTL";
RGMII1.TD0.$assign                = "RGMII1_TD0";
RGMII1.TD1.$assign                = "RGMII1_TD1";
RGMII1.TD2.$assign                = "RGMII1_TD2";
RGMII1.TD3.$assign                = "RGMII1_TD3";
RGMII1.TXC.$assign                = "RGMII1_TXC";
RGMII1.TX_CTL.$assign             = "RGMII1_TX_CTL";
const SPI1                        = scripting.addPeripheral("SPI");
SPI1.$useCase                     = "SPI_1";
SPI1.$name                        = "nRF52840";
SPI1.$assign                      = "SPI0";
SPI1.CLK.$assign                  = "SPI0_CLK";
SPI1.D0.rx                        = false;
SPI1.D0.$assign                   = "SPI0_D0";
SPI1.D1.$assign                   = "SPI0_D1";
SPI1.CS0.rx                       = false;
SPI1.CS0.$assign                  = "SPI0_CS0";
SPI1.CS1.rx                       = false;
SPI1.CS1.$used                    = false;
SPI1.CS2.rx                       = false;
SPI1.CS2.$used                    = false;
SPI1.CS3.rx                       = false;
SPI1.CS3.$used                    = false;
const UART1                       = scripting.addPeripheral("UART");
UART1.$name                       = "CC2652P";
UART1.$assign                     = "USART6";
UART1.$assignVoltage              = "3.3 V";
UART1.CTSn.$assign                = "OSPI0_D7";
UART1.DCDn.$used                  = false;
UART1.DSRn.$used                  = false;
UART1.DTRn.$used                  = false;
UART1.RIn.$used                   = false;
UART1.RTSn.$assign                = "OSPI0_D6";
UART1.RXD.$assign                 = "OSPI0_D4";
UART1.TXD.$assign                 = "OSPI0_D5";
const USB1                        = scripting.addPeripheral("USB");
USB1.$name                        = "USB C";
USB1.$assign                      = "USB0";
USB1.DM.$assign                   = "USB0_DM";
USB1.DP.$assign                   = "USB0_DP";
USB1.DRVVBUS.$used                = false;
USB1.RCALIB.$assign               = "USB0_RCALIB";
USB1.VBUS.$assign                 = "USB0_VBUS";
const USB2                        = scripting.addPeripheral("USB");
USB2.$name                        = "USB A";
USB2.$assign                      = "USB1";
USB2.DM.$assign                   = "USB1_DM";
USB2.DP.$assign                   = "USB1_DP";
USB2.DRVVBUS.$assign              = "USB1_DRVVBUS";
USB2.RCALIB.$assign               = "USB1_RCALIB";
USB2.VBUS.$assign                 = "USB1_VBUS";
scripting.suppress("Voltage conflict,VDDSHV0 is set to 3\\.3 V", USB2, "DRVVBUS");
const WKUP_LFOSC1                 = scripting.addPeripheral("WKUP_LFOSC");
WKUP_LFOSC1.$name                 = "WKUP_LFOSC1";
WKUP_LFOSC1.XI.$assign            = "WKUP_LFOSC0_XI";
WKUP_LFOSC1.XO.$assign            = "WKUP_LFOSC0_XO";
const WKUP_SYSTEM1                = scripting.addPeripheral("WKUP_SYSTEM");
WKUP_SYSTEM1.$name                = "WKUP_SYSTEM";
WKUP_SYSTEM1.WKUP_CLKOUT0.$used   = false;
WKUP_SYSTEM1.PMIC_LPM_EN0.pu_pd   = "pu";
WKUP_SYSTEM1.PMIC_LPM_EN0.$assign = "PMIC_LPM_EN0";

/**
 * Pinmux solution for unlocked pins/peripherals. This ensures that minor changes to the automatic solver in a future
 * version of the tool will not impact the pinmux you originally saw.  These lines can be completely deleted in order to
 * re-solve from scratch.
 */
DDRSS1.$suggestSolution       = "DDR0";
GPIO1.$suggestSolution        = "GPIO0";
MMC01.$suggestSolution        = "MMC0";
MMC11.$suggestSolution        = "MMC1";
RGMII1.$suggestSolution       = "RGMII1";
WKUP_LFOSC1.$suggestSolution  = "WKUP_LFOSC0";
WKUP_SYSTEM1.$suggestSolution = "WKUP_SYSTEM";
